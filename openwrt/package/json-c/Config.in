## openwrt/package/json-c/Config.in
```kconfig
config BR2_PACKAGE_JSON-C
	prompt "json-c............................ json-c"
	tristate
	default n if CONFIG_DEVEL
	help
          json-c
```

## openwrt/package/libubox/Config.in
```kconfig
config BR2_PACKAGE_LIBUBOX
	prompt "libubox.......................... OpenWRT library"
	tristate
	default n if CONFIG_DEVEL
	select BR2_PACKAGE_JSON-C
	help
	OpenWRT utility library, supports ubus
```

## openwrt/package/stress/Config.in
```kconfig
config BR2_PACKAGE_STRESS
       prompt "stress............................ System Stress Utility"
       bool
       default y
       help
         stress is a simple tool that imposes certain types of compute stress
         on UNIX-like operating systems.

         http://openwrt.org/packages/pkgdata_lede17_1/stress
```

## openwrt/package/talloc/Config.in
```kconfig
config BR2_PACKAGE_TALLOC
	prompt "talloc...........................ref counted mem pool library"
	tristate
	default m if CONFIG_DEVEL
	help
	  talloc is a hierarchical, reference counted memory pool system with
	  destructors. It is the core memory allocator used in Samba.

	  https://talloc.samba.org/talloc/doc/html/index.html
```

## openwrt/package/ubus/Config.in
```kconfig
config BR2_PACKAGE_UBUS
	prompt "ubus.......................... IPC Daemon"
	tristate
	default n if CONFIG_DEVEL
	select BR2_PACKAGE_LIBUBOX
	select BR2_PACKAGE_JSON-C
	help
	Light-weight IPC daemon from OpenWRT
```

## openwrt/toolchain/gcc/Config.in
```kconfig
# Choose gcc version.
# WARNING -- 2.95 currently only builds for i386, arm, mips*, and powerpc.
# WARNING -- 2.95 does not currently build natively for the target.

if CONFIG_DEVEL
	comment "Gcc Options"
endif


choice
	prompt "GCC compiler Version" if CONFIG_DEVEL
	default BR2_GCC_VERSION_4_8_3
	help
	  Select the version of gcc you wish to use.


    config BR2_GCC_VERSION_4_5_3
    	bool "gcc 4.5.3"

    config BR2_GCC_VERSION_4_6_2
	bool "gcc 4.6.2"

    config BR2_GCC_VERSION_4_6_3
	bool "gcc 4.6.3"

    config BR2_GCC_VERSION_4_7_0
	bool "gcc 4.7.0"

    config BR2_GCC_VERSION_4_7_1
	bool "gcc 4.7.1"

    config BR2_GCC_VERSION_4_8_3
	bool "gcc 4.8.3"

    config BR2_GCC_VERSION_5_4_0
	bool "gcc 5.4.0"

    config BR2_GCC_VERSION_6_3_0
	bool "gcc 6.3.0"

    config BR2_GCC_VERSION_6_4_0
	bool "gcc 6.4.0"

    config BR2_GCC_VERSION_6_5_0
	bool "gcc 6.5.0"

    config BR2_GCC_VERSION_7_3_0
	bool "gcc 7.3.0"

endchoice

# more nasty hacks
config BR2_PACKAGE_LIBGCC
	tristate
	default m if CONFIG_DEVEL
	default n

config BR2_GCC_VERSION
	string
	default "4.5.3"	    if BR2_GCC_VERSION_4_5_3
	default "4.6.2"	    if BR2_GCC_VERSION_4_6_2
	default "4.6.3"	    if BR2_GCC_VERSION_4_6_3
	default "4.7.0"	    if BR2_GCC_VERSION_4_7_0
	default "4.7.1"	    if BR2_GCC_VERSION_4_7_1
	default "5.4.0"	    if BR2_GCC_VERSION_5_4_0
	default "6.3.0"	    if BR2_GCC_VERSION_6_3_0
	default "6.4.0"	    if BR2_GCC_VERSION_6_4_0
	default "6.5.0"	    if BR2_GCC_VERSION_6_5_0
	default "7.3.0"	    if BR2_GCC_VERSION_7_3_0
	default "4.8.3"


config BR2_GCC_USE_SJLJ_EXCEPTIONS
	string
#	default "--enable-sjlj-exceptions"
	default ""
	help
	    Currently the unwind stuff seems to work for staticly linked apps
	    but not dynamic.  So use setjmp/longjmp exceptions by default.

config BR2_EXTRA_GCC_CONFIG_OPTIONS
	string
	prompt "Additional gcc options" if CONFIG_DEVEL
	default ""
	help
	    Any additional gcc options you may want to include....

config BR2_INSTALL_LIBSTDCPP
	bool
	prompt "Build/install c++ compiler and libstdc++?" if CONFIG_DEVEL
	default y
	help
	    Build/install c++ compiler and libstdc++?

config INSTALL_LIBGCJ
        bool
        prompt "Build/install java compiler and GNU classpath ?" if TOOLCHAINOPTS
        default n
        help
            Build/install java compiler and GNU classpath ?
```

## openwrt/toolchain/musl/Config.in
```kconfig
if BR2_LIBC_MUSL
comment "musl options"

choice
	prompt "musl Version"
	depends BR2_LIBC_MUSL
	default BR2_MUSL_VERSION_1_1_20

	help
	  Select the version of musl you wish to use.


	config BR2_MUSL_VERSION_1_1_18
		bool "musl 1.1.18"
	config BR2_MUSL_VERSION_1_1_19
		bool "musl 1.1.19"
	config BR2_MUSL_VERSION_1_1_20
		bool "musl 1.1.20"

endchoice

config BR2_MUSL_VERSION
	string
	depends BR2_LIBC_MUSL
	default "1.1.18" if BR2_MUSL_VERSION_1_1_18
        default "1.1.19" if BR2_MUSL_VERSION_1_1_19
        default "1.1.20" if BR2_MUSL_VERSION_1_1_20

endif
```
